#include "key.h"
#include "delay.h"

/******************************************************************************
**函数信息 ：key_init
**功能描述 ：按键初始化为输入GPIO
**输入参数 ：
**输出参数 ：
**调用提示 ：
******************************************************************************/
void key_init()
{
  RCC->AHB1ENR |= 1 << 0;   //PA时钟使能
  GPIOA->MODER &= ~(3 << 0);//PA0   通用输入
  GPIOA->PUPDR &= ~(3 << 0);//PA0   无上下拉
}
/******************************************************************************
**函数信息 ：key_scan
**功能描述 ：按键检测
**输入参数 ：
**输出参数 ：按键按下，返回1，按键松开返回0
**调用提示 ：
******************************************************************************/
u8 key_scan()
{
  static u8 key_sta = 1;
  
  if (key_sta &&  ( KEY==1))   //按键按下，且状态锁处于解锁状态
  {
    key_sta = 0; //锁上按键状态锁
    delay_ms(10);//去抖动
    
    if (KEY == 1)//去抖动后，按键的输入电平为高电平，则按键按下
    {
      return 1;  //按键按下，返回1
    }
    
  }
  else if (KEY == 0)
  {
    key_sta = 1;
  }
  
  return 0;
}
